## drivers/staging/kernelsu/Kconfig
```kconfig
menu "KernelSU"

config KSU
	tristate "KernelSU function support"
	depends on OVERLAY_FS
	help
	  Enable kernel-level root privileges on Android System.
	  To compile as a module, choose M here: the
	  module will be called kernelsu.

config KSU_DEBUG
	bool "KernelSU debug mode"
	depends on KSU
	default n
	help
	  Enable KernelSU debug mode.

config KSU_CUSTOM_SIGN_KEY
	bool "Allows custom APK signing keys"
	depends on KSU && KSU != m
	default n
	help
	  Allows specifying an additional available APK signing key via module parameters.

endmenu
```

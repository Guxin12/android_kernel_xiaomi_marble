&mdss_mdp {
	dsi_m16t_36_02_0a_dsc_vid: qcom,mdss_dsi_m16t_36_02_0a_dsc_vid {
		qcom,mdss-dsi-panel-name = "xiaomi 36 02 0a video mode dsc dsi panel";
		qcom,mdss-dsi-panel-type = "dsi_video_mode";
		qcom,mdss-dsi-virtual-channel-id = <0>;
		qcom,mdss-dsi-stream = <0>;
		qcom,mdss-dsi-bpp = <30>;
		qcom,mdss-dsi-color-order = "rgb_swap_rgb";
		qcom,mdss-dsi-underflow-color = <0xff>;
		qcom,mdss-dsi-border-color = <0>;

		qcom,dsi-ctrl-num = <0>;
		qcom,dsi-phy-num = <0>;

		qcom,mdss-dsi-traffic-mode = "burst_mode";
		qcom,mdss-dsi-lane-map = "lane_map_0123";
		qcom,mdss-dsi-bllp-eof-power-mode;
		qcom,mdss-dsi-bllp-power-mode;
		qcom,mdss-dsi-lane-0-state;
		qcom,mdss-dsi-lane-1-state;
		qcom,mdss-dsi-lane-2-state;
		qcom,mdss-dsi-lane-3-state;
		qcom,mdss-dsi-dma-trigger = "trigger_sw";
		qcom,mdss-dsi-mdp-trigger = "none";
		qcom,mdss-dsi-reset-sequence =  <1 11>, <0 1>, <1 11>;
		qcom,mdss-pan-physical-width-dimension = <70>;
		qcom,mdss-pan-physical-height-dimension = <154>;

		qcom,mdss-dsi-tx-eot-append;
		qcom,mdss-dsi-lp11-init;
		qcom,mdss-dsi-bl-inverted-dbv;
		qcom,bl-update-flag = "delay_until_first_frame";
		// qcom,mdss-dsi-phy-voltage = <0x51>;

		qcom,mdss-dsi-panel-hdr-enabled;
		qcom,mdss-dsi-panel-hdr-color-primaries = <14500 15500 32000 17000 15500 30000 8000 3000>;
		qcom,mdss-dsi-panel-peak-brightness = <4200000>;
		qcom,mdss-dsi-panel-blackness-level = <3230>;

		qcom,mdss-dsi-pan-enable-dynamic-fps;
		qcom,mdss-dsi-pan-fps-update =
			"dfps_immediate_porch_mode_vfp";
		qcom,dsi-supported-dfps-list = <60 120 90>;

		qcom,mdss-dsi-display-timings {
			timing@0{
				qcom,mdss-dsi-video-mode;
				qcom,mdss-dsi-panel-framerate = <120>;
				qcom,mdss-dsi-panel-width = <1080>;
				qcom,mdss-dsi-panel-height = <2400>;
				qcom,mdss-dsi-h-front-porch = <48>;
				qcom,mdss-dsi-h-back-porch = <64>;
				qcom,mdss-dsi-h-pulse-width = <4>;
				qcom,mdss-dsi-h-sync-skew = <0>;
				qcom,mdss-dsi-v-back-porch = <10>;
				qcom,mdss-dsi-v-front-porch = <20>;
				qcom,mdss-dsi-v-pulse-width = <2>;
				qcom,mdss-dsi-h-sync-pulse = <0>;
				qcom,mdss-dsi-h-left-border = <0>;
				qcom,mdss-dsi-h-right-border = <0>;
				qcom,mdss-dsi-v-top-border = <0>;
				qcom,mdss-dsi-v-bottom-border = <0>;

				qcom,mdss-dsi-on-command = [
					/*optimize*/
					39 00 00 00 00 00 05 FF AA 55 A5 80
					39 00 00 40 00 00 02 6F 14
					39 00 00 40 00 00 02 F4 40
					/*Source Setting*/
					39 00 00 00 00 00 05 FF AA 55 A5 80
					39 00 00 40 00 00 02 6F 17
					39 00 00 40 00 00 02 F4 02
					39 00 00 40 00 00 05 FF AA 55 A5 81
					39 00 00 40 00 00 02 6F 13
					39 00 00 40 00 00 02 F9 01
					/*AOD Video Mode*/
					39 00 00 40 00 00 02 17 03
					39 00 00 40 00 00 02 71 00
					39 00 00 40 00 00 09 8D 00 00 04 37 00 00 09 5F
					/*Set video drop time*/
					39 00 00 40 00 00 05 FF AA 55 A5 81
					39 00 00 40 00 00 02 6F 3C
					39 00 00 40 00 00 02 F5 81
					/*CMD_P1 */
					39 00 00 40 00 00 06 F0 55 AA 52 08 01
					39 00 00 40 00 00 02 6F 03
					/* ELVDD_LVDET_OFF */
					39 00 00 40 00 00 02 C7 07
					/* CMD_P0 */
					39 00 00 40 00 00 06 F0 55 AA 52 08 00
					39 00 00 40 00 00 04 B9 00 04 38
					39 00 00 40 00 00 03 BD 09 60
					/* CASET/PASET Setting 1080X2400*/
					39 00 00 40 00 00 05 2A 00 00 04 37
					39 00 00 40 00 00 05 2B 00 00 09 5F
					/* COMPRESSION_METHOD */
					39 00 00 40 00 00 03 90 03 03
					/*pps setting*/
					39 00 00 40 00 00 13 91 AB A8 00 14 D2 00
						02 25 01 D5 00 07 05 7A 05 16 10 F0
					39 00 00 40 00 00 13 93 AB A8 00 14 D2 00
						02 25 01 D5 00 07 05 7A 05 16 10 F0
					39 00 00 40 00 00 13 95 AB A8 00 14 D2 00
						02 25 01 D5 00 07 05 7A 05 16 10 F0
					39 00 00 40 00 00 13 97 AB A8 00 14 D2 00
						02 25 01 D5 00 07 05 7A 05 16 10 F0
					/* BCTRL */
					39 00 00 40 00 00 02 53 20
					/* VBP/VFP Mode */
					39 00 00 40 00 00 05 3B 00 0C 00 14
					/* TE ON Setting */
					39 00 00 40 00 00 02 35 00
					/* DBV */
					39 00 00 40 00 00 07 51 00 00 00 00 00 00
					/*dimming setting*/
					39 00 00 40 00 00 06 F0 55 AA 52 08 00
					39 00 00 40 00 00 02 B2 08
					39 00 00 40 00 00 02 6F 05
					39 00 00 40 00 00 03 B2 04 04
					/* 120hz: 00; 90hz:01; 60hz:02 */
					39 00 00 40 00 00 02 2F 00
					/* GIR off */
					39 00 00 40 00 00 02 5F 01
					39 00 00 40 00 00 02 26 00
					39 00 00 40 00 00 06 F0 55 AA 52 08 00
					39 00 00 40 00 00 02 6F 03
					39 00 00 40 00 00 02 C0 20
					/* ESD CONFIG */
					39 00 00 40 00 00 06 F0 55 AA 52 08 00
					39 00 00 40 00 00 03 BE 47 00
					39 00 00 40 00 00 02 6F 05
					39 00 00 40 00 00 02 BE 18
					39 00 00 40 00 00 02 6F 0F
					39 00 00 40 00 00 03 BE FB FB
					/* round on */
					39 00 00 40 00 00 06 F0 55 AA 52 08 07
					39 00 00 40 00 00 02 C0 87
					/*IC may reload failed, force reload gamma again*/
					39 00 00 40 00 00 06 F0 55 AA 52 08 01
					39 00 00 40 00 00 02 E8 30
					39 00 00 40 00 00 05 FF AA 55 A5 84
					39 00 00 40 00 00 02 6F 21
					39 00 00 40 00 00 07 F4 FF FF F9 FF FF FF
					39 00 00 40 00 00 02 6F 9C
					39 00 00 40 00 00 03 F4 FF C0
					/* Sleep Out */
					39 00 00 00 78 00 02 11 00
					/* Display On */
					39 00 00 00 00 00 02 29 00
					/* CMD_P1 */
					39 00 00 00 00 00 06 F0 55 AA 52 08 01
					39 00 00 40 00 00 02 6F 03
					39 00 00 00 00 00 02 C7 47
					/* ESD Detection*/
					39 00 00 00 00 00 06 F0 55 AA 52 08 00
					39 00 00 00 00 00 03 BE 47 C5
					/* close page */
					39 00 00 40 00 00 06 F0 55 AA 52 00 00
					39 00 00 00 00 00 05 FF AA 55 A5 00
				];
				qcom,mdss-dsi-off-command = [
					39 00 00 00 14 00 02 28 00
					39 00 00 00 78 00 02 10 00
				];
				qcom,mdss-dsi-on-command-state = "dsi_lp_mode";
				qcom,mdss-dsi-off-command-state = "dsi_lp_mode";

				qcom,mdss-dsi-nolp-command = [
					39 00 00 40 00 00 07 51 00 00 00 00 00 00
					39 00 00 00 00 00 02 38 00
				];
				qcom,mdss-dsi-nolp-command-state = "dsi_hs_mode";
				qcom,mdss-dsi-nolp-command-update = <0x51 0 6>;

				/* DSC CONFIG*/
				qcom,compression-mode = "dsc";
				qcom,mdss-dsc-version = <0x12>;
				qcom,mdss-dsc-scr-version = <0x0>;
				qcom,mdss-dsc-slice-height = <20>;
				qcom,mdss-dsc-slice-width = <540>;
				qcom,mdss-dsc-slice-per-pkt = <2>;
				qcom,mdss-dsc-bit-per-component = <10>;
				qcom,mdss-dsc-bit-per-pixel = <8>;
				qcom,mdss-dsc-block-prediction-enable;
			};
		};
	};
};

&dsi_m16t_36_02_0a_dsc_vid {
	mi,panel-id = <0x4D313654 0x00360200>;

	mi,max-brightness-clone = <16383>;
	mi,normal-max-brightness-clone = <4095>;
	mi,mdss-dsi-fac-bl-max-level = <2047>;
	mi,mdss-fac-brightness-max-level = <2047>;

	mi,thermal-dimming-flag;
	mi,panel-on-dimming-delay = <120>;
	mi,dimming-need-update-speed;
	mi,dimming-node = <0 200 450 800 4095>;

	/* AOD CONFIG*/
	mi,doze-hbm-dbv-level = <245>;
	mi,doze-lbm-dbv-level = <20>;

	/* IRQ CHECK: IRQF_ONESHOT | IRQF_TRIGGER_LOW */
	mi,esd-err-irq-gpio = <&tlmm 116 0x2008>;
	mi,panel-ignore-esd-in-aod;

	mi,ddic-round-corner-enabled;

	qcom,mdss-dsi-display-timings {
		timing@0{

			mi,mdss-dsi-hbm-on-command = [39 00 00 00 00 00 03 51 07 FF];
			mi,mdss-dsi-hbm-on-command-state = "dsi_hs_mode";
			mi,mdss-dsi-hbm-off-command = [39 00 00 00 00 00 03 51 07 FF];
			mi,mdss-dsi-hbm-off-command-state = "dsi_hs_mode";

			mi,mdss-dsi-flat-mode-on-command = [
				39 00 00 00 00 00 02 5F 00
				39 00 00 40 00 00 02 26 03
				39 00 00 00 00 00 06 F0 55 AA 52 08 00
				39 00 00 40 00 00 02 6F 03
				39 00 00 00 00 00 02 C0 53
				39 00 00 00 00 00 06 F0 55 AA 52 00 00
			];
			mi,mdss-dsi-flat-mode-on-command-state = "dsi_hs_mode";

			mi,mdss-dsi-flat-mode-off-command = [
				39 00 00 00 00 00 02 5F 01
				39 00 00 40 00 00 02 26 00
				39 00 00 00 00 00 06 F0 55 AA 52 08 00
				39 00 00 40 00 00 02 6F 03
				39 00 00 00 00 00 02 C0 20
				39 00 00 00 00 00 06 F0 55 AA 52 00 00
			];
			mi,mdss-dsi-flat-mode-off-command-state = "dsi_hs_mode";

			mi,mdss-dsi-aod-enter-command = [
				39 00 00 00 00 00 02 39 00
			];
			mi,mdss-dsi-aod-enter-command-state = "dsi_hs_mode";

			mi,mdss-dsi-aod-exit-command = [
				39 00 00 40 00 00 02 38 00
			];
			mi,mdss-dsi-aod-exit-command-state = "dsi_hs_mode";

			mi,mdss-dsi-doze-hbm-command = [
				39 00 00 00 00 00 07 51 00 F5 07 FF 03 FF
			];
			mi,mdss-dsi-doze-hbm-command-state = "dsi_hs_mode";

			mi,mdss-dsi-doze-lbm-command = [
				39 00 00 00 00 00 07 51 00 14 07 FF 01 FF
			];
			mi,mdss-dsi-doze-lbm-command-state = "dsi_hs_mode";

			mi,mdss-dsi-doze-hbm-nolp-command = [
				39 00 00 00 00 00 07 51 00 00 00 00 00 00
			];
			mi,mdss-dsi-doze-hbm-nolp-command-state = "dsi_hs_mode";

			mi,mdss-dsi-doze-lbm-nolp-command = [
				39 00 00 00 00 00 07 51 00 00 00 00 00 00
			];
			mi,mdss-dsi-doze-lbm-nolp-command-state = "dsi_hs_mode";

			mi,mdss-dsi-fps-120-gamma-command = [
				39 00 00 00 00 00 02 2F 00
			];
			mi,mdss-dsi-fps-120-gamma-command-state = "dsi_hs_mode";

			mi,mdss-dsi-fps-90-gamma-command = [
				39 00 00 00 00 00 02 2F 01
			];
			mi,mdss-dsi-fps-90-gamma-command-state = "dsi_hs_mode";

			mi,mdss-dsi-fps-60-gamma-command = [
				39 00 00 00 00 00 02 2F 02
			];
			mi,mdss-dsi-fps-60-gamma-command-state = "dsi_hs_mode";

			/* enable video trim*/
			mi,mdss-dsi-aod-enable-video-trim-command = [
				39 00 00 40 00 00 06 F0 55 AA 52 08 01
				39 00 00 40 00 00 02 EA 91
				39 00 00 00 00 00 06 F0 55 AA 52 00 00
			];
			mi,mdss-dsi-aod-enable-video-trim-command-state = "dsi_hs_mode";

			/* disable video trim*/
			mi,mdss-dsi-aod-disable-video-trim-command = [
				39 00 00 40 00 00 06 F0 55 AA 52 08 01
				39 00 00 40 00 00 02 EA 11
				39 00 00 00 00 00 06 F0 55 AA 52 00 00
			];
			mi,mdss-dsi-aod-disable-video-trim-command-state = "dsi_hs_mode";

		};
	};
};

/dts-v1/;
/plugin/;

#include <dt-bindings/clock/qcom,gcc-diwali.h>
#include <dt-bindings/clock/qcom,camcc-diwali.h>
#include <dt-bindings/interconnect/qcom,diwali.h>
#include <dt-bindings/interrupt-controller/arm-gic.h>
#include <dt-bindings/regulator/qcom,rpmh-regulator-levels.h>

#include "ziyi-sm7450-camera-sensor.dtsi"
/ {
	model = "Qualcomm Technologies, Inc. 7450 ziyi";
	compatible = "qcom,diwali";
	qcom,msm-id = <506 0x10000>, <547 0x10000>, <564 0x10000>;
	qcom,board-id = <34 0>, <34 2>, <34 3>;
	xiaomi,miboard-id = <0x9 0>;
};
